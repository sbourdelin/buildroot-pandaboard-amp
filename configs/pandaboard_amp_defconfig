## configs/pandaboard_amp_defconfig
```kconfig
BR2_arm=y
BR2_cortex_a9=y
BR2_TARGET_GENERIC_ROOT_PASSWD="root"
BR2_TARGET_GENERIC_GETTY_PORT="ttyO2"
BR2_ROOTFS_POST_IMAGE_SCRIPT="board/pandaboard-amp/post-image.sh"
BR2_LINUX_KERNEL=y
BR2_LINUX_KERNEL_CUSTOM_GIT=y
BR2_LINUX_KERNEL_CUSTOM_REPO_URL="http://git.ti.com/git/rpmsg/remoteproc.git"
BR2_LINUX_KERNEL_CUSTOM_REPO_VERSION="e17e309fdba1b6113374e884e427031c8fa5e3b3"
BR2_LINUX_KERNEL_USE_CUSTOM_CONFIG=y
BR2_LINUX_KERNEL_CUSTOM_CONFIG_FILE="board/pandaboard-amp/linux-4.1-ti-remoteproc-pandaboard-amp.config"
BR2_LINUX_KERNEL_APPENDED_UIMAGE=y
BR2_LINUX_KERNEL_UIMAGE_LOADADDR="0x80008000"
BR2_LINUX_KERNEL_INTREE_DTS_NAME="omap4-panda"
BR2_PACKAGE_DROPBEAR=y
# BR2_PACKAGE_DROPBEAR_CLIENT is not set
BR2_TARGET_ROOTFS_EXT2=y
# BR2_TARGET_ROOTFS_TAR is not set
BR2_PACKAGE_HOST_GENIMAGE=y
```

## package/pandaboard-amp/Config.in
```kconfig
source "package/pandaboard-amp/rpboot/Config.in"
source "package/pandaboard-amp/rpgpio/Config.in"
source "package/pandaboard-amp/rpfreertos/Config.in"
```

## package/pandaboard-amp/rpboot/Config.in
```kconfig
comment "rpboot needs a Linux kernel to be built"
	depends on !BR2_LINUX_KERNEL

config BR2_PACKAGE_RPBOOT
	bool "rpboot"
	depends on BR2_LINUX_KERNEL
	help
	  the rpboot driver is used to boot the ducati processor.
```

## package/pandaboard-amp/rpfreertos/Config.in
```kconfig
config BR2_PACKAGE_RPFREERTOS
	bool "rpfreertos"
	help
	  the rpfreertos package build a demo FreeRTOS firmware compliant
	  with the Linux remoteproc framework.

if BR2_PACKAGE_RPFREERTOS

config BR2_PACKAGE_RPFREERTOS_TOOLCHAIN
	string "path to the ARM Cortex M toolchain to use?"
	default "/path/to/arm-none-eabi/bin/arm-none-eabi-"
	help
	  the rpfreertos package need a toolchain for ARM Cortex M serie
	  you can download one from https://launchpad.net/gcc-arm-embedded

endif # BR2_PACKAGE_RPFREERTOS
```

## package/pandaboard-amp/rpgpio/Config.in
```kconfig
comment "rpgpio needs a Linux kernel to be built"
	depends on !BR2_LINUX_KERNEL

config BR2_PACKAGE_RPGPIO
	bool "rpgpio"
	depends on BR2_LINUX_KERNEL
	help
	  A simple driver used to request an IRQ on a GPIO and toggle an other GPIO in the interupt handler.
```
